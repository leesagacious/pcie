/*
  this node define a fixed voltage regulator providing 3.3V power
  for PCIe 3.0 interface

  after enabling this regulator, all PCIe devices connected to this power
  domain will receive 3.3v power simultaneously

	  ┌─────────────┐      ┌─────────────┐
	│ PCIe Slot 1  │      │ PCIe SSD     │
	│ (3.3V)       │◄────┤ (3.3V)       │
	└─────────────┘      └─────────────┘
		▲                  ▲
		│                  │
	┌───────┴──────────────────┴───────┐
	│      vcc3v3_pcie30 (3.3V)        │
	└──────────────────────────────────┘
			   ▲
			   │
		    ┌──────┴──────┐
		    │ vcc12v_dcin │ (12V)
*/
vcc3v3_pcie30: vcc3v3-pcie30 {
	compatible = "regulator-fixed";
	regulator-name = "vcc3v3_pcie30";
	regulator-min-microvolt = <3300000>;
	regulator-max-microvolt = <3300000>;
	/*
         the enable signal is active-high(i.e., the regulator is enabled when the GPIO output
	 a high level)
         */
	enable-active-high;
	/*
 	 * the regulator's enable status is controlled via GPIO. 3c3 115
	 */
	gpios = <&gpio3 RK_PC3 GPIO_ACTIVE_HIGH>;
	/*
	   after enabling the gpio. the system needs to wait for 5ms before detecting the output.
	   ensuring the voltage is stable before it is used by the PCIe device.
	   this accounts for the rise time of the power circuit and avoids initialization failures
	   caused by unstable voltage
         */
	startup-delay-us = <5000>;
	vin-supply = <&vcc12v_dcin>;
};


/*
 * PCIe 3x4 node is used to describe the hardware configuration of 
   a PCIe 3.0x4 interface controller, Define the register addresses, 
   interrupt mapping, power management, and pin control properties of 
   the controller
 */
pcie3x4:pcie@fe150000 {

	reg = <0x0 0xfe160000 0x0 0x10000>,
	      <0xa 0x40400000 0x0 0x400000>;
	reg-names = "pcie-apb","pcie-dbi"

	/*
    	  receive the INTx signals from PCI devices
          converts legacy PCI interrupts into modern interrupt formats
  	  forwards the interrupts to the system-level interrupt controller(GIC)

	  +---------------------+     +--------------------+      +-----------------------+
		| PCIe设备            |     | PCIe主机控制器      |      | 系统中断控制器        |
		|                     |     | (Root Complex)      |      | (例如GIC)             |
		|    INTx#信号 -------+---->|                     |      |                       |
		|                     |     | legacy-interrupt-   |      |                       |
		+---------------------+     | controller节点      |      |                       |
				    	    |   - interrupt-      |      |                       |
				    	    |     controller      |      |                       |
				    	    |   - #interrupt-     |      |                       |
				    	    |     cells = <1>     |      |                       |
				    	    |   - interrupts      |      |                       |
				    	    |    属性指向GIC       +---->| 对应GIC中断线         |
				    	    |                     |      |                       |
				    	    +--------------------+      +-----------------------+
		 */
	pcie3x4_intc: legcy-interrupt-controller {
		/*
                  this is an empty property used to identify the node as an interrupt controller.
		  it indicates that the node is responseible for managing the routing and handling
 		  of  interrupt requests.
                 */
		interrupt-controller;
		#address-cells = <0>;
		#interrupt-cells = <1>;
		interrupt-parent = <&gic>;
		/*
		 the legacy interrupt of the PCIe controller in RK3588 is fixedly assigned to GIC_SPI 260
		 The output (logical) interrupt lines of the pcie3x4_intc (RK3588 PCIe controller's 
		 legacy interrupt controller) are physically hardwired to interrupt line SPI 260 of the ARM GIC (Generic Interrupt Controller).
		*/
		interrupts = <GIC_SPI 260 IRQ_TYPE_EDGE_RISING>;
	};
	status = "disabled";
};
